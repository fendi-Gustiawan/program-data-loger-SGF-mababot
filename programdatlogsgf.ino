#include <Wire.h>
#include <Adafruit_GFX.h>
#include <Adafruit_SSD1306.h>
#include <SD.h>
#include <SPI.h>
#include <RTClib.h>

// Konfigurasi perangkat keras
#define SCREEN_WIDTH 128
#define SCREEN_HEIGHT 64
#define OLED_RESET -1
#define OLED_I2C_ADDRESS 0x3C
#define SD_CS_PIN 5

// Pin untuk sensor arus
#define AC712_PIN 34  // Gunakan pin 33 sesuai yang Anda sebutkan

Adafruit_SSD1306 display(SCREEN_WIDTH, SCREEN_HEIGHT, &Wire, OLED_RESET);
File dataFile;
RTC_DS3231 rtc;

const unsigned char NaN [] PROGMEM = {
	// 'sgf, 128x64px
	0x00, 0x00, 0x00, 0x00, 0x00, 0x00, 0x00, 0x00, 0x00, 0x00, 0x00, 0x00, 0x00, 0x00, 0x00, 0x00, 
	0x00, 0x00, 0x00, 0x00, 0x00, 0x00, 0x00, 0x00, 0x00, 0x00, 0x00, 0x00, 0x00, 0x00, 0x00, 0x00, 
	0x00, 0x00, 0x00, 0x00, 0x00, 0x00, 0x00, 0x00, 0x00, 0x00, 0x00, 0x00, 0x00, 0x00, 0x00, 0x00, 
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	0x00, 0x00, 0x00, 0x00, 0x00, 0x00, 0x00, 0x00, 0x00, 0x00, 0x00, 0x00, 0x00, 0x00, 0x00, 0x00
};

void showLogoAndTeamName() {
    display.clearDisplay();
    display.drawBitmap(0, 0, NaN, SCREEN_WIDTH, SCREEN_HEIGHT, SSD1306_WHITE);
    display.display();
    delay(3000); // Tampilkan logo selama 3 detik

    display.clearDisplay();
    display.setTextSize(1);
    display.setTextColor(SSD1306_WHITE);
    display.setCursor(0, 0);
    display.println("Team SGF (MABA BOT):");
    display.setCursor(0, 10);
    display.println("Sakinah");
    display.setCursor(0, 20);
    display.println("Gabriel");
    display.setCursor(0, 30);
    display.println("Fendi");
    display.display();
    delay(3000); // Tampilkan nama tim selama 3 detik
}

void setup() {
    Serial.begin(9600);
    
    if (!display.begin(SSD1306_SWITCHCAPVCC, OLED_I2C_ADDRESS)) {
        Serial.println(F("SSD1306 allocation failed"));
        while (1);
    }

    showLogoAndTeamName();
    display.clearDisplay();
    display.setTextSize(1);
    display.setTextColor(SSD1306_WHITE);
    display.setCursor(0, 0);
    display.println("Initializing...");
    display.display();
    delay(1000);
    
    if (!SD.begin(SD_CS_PIN)) {
        Serial.println("SD Card initialization failed!");
        display.clearDisplay();
        display.println("SD Init Failed!");
        display.display();
        while (1);
    }
    Serial.println("SD Card initialized.");
    display.clearDisplay();
    display.println("SD Card OK");
    display.display();
    delay(1000);
    
    Wire.begin();
    if (!rtc.begin()) {
        Serial.println("RTC tidak terdeteksi!");
        while (1);
    }

    if (rtc.lostPower()) {
        Serial.println("RTC kehilangan daya. Mengatur waktu...");
        rtc.adjust(DateTime(F(__DATE__), F(__TIME__))); 
    }
    pinMode(AC712_PIN, INPUT);
}

void loop() {
    DateTime now = rtc.now();
    now = now + TimeSpan(0, 0, 22, 0);

    int rawValue = analogRead(AC712_PIN);
    float voltage = (rawValue / 1024.0) * 5.0; 
    float current = (voltage - 2.5) / 0.185; // Ubah 0.185 jika faktor skala berbeda

    // Cek nilai current
    if (current < 0.1) {
        current = 0.0; 
    }

    if (current > 0.1) {
        String dataString = String(now.year()) + "-" + String(now.month()) + "-" + String(now.day()) + " " +
                            String(now.hour()) + ":" + String(now.minute()) + ":" + String(now.second()) + " " +
                            String(current);

        dataFile = SD.open("/dataSGF.txt", FILE_WRITE);
        if (dataFile) {
            dataFile.println(dataString);
            dataFile.close();
            Serial.println("Data logged to SD card: " + dataString);
        } else {
            Serial.println("Error opening data.txt");
        }

        display.clearDisplay();
        display.setTextSize(1);
        display.setTextColor(SSD1306_WHITE);
        display.setCursor(0, 0);
        display.println("Current: ");
        display.print(current);
        display.println(" A");
        display.setCursor(0, 40);
        display.print("Date: ");
        display.print(now.year());
        display.print('-');
        display.print(now.month());
        display.print('-');
        display.print(now.day());
        display.setCursor(0, 50);
        display.print("Time: ");
        display.print(now.hour());
        display.print(':');
        display.print(now.minute());
        display.print(':');
        display.print(now.second());
        display.display();

        Serial.print("Current: ");
        Serial.print(current);
        Serial.print(" A | Tanggal: ");
        Serial.print(now.year());
        Serial.print('-');
        Serial.print(now.month());
        Serial.print('-');
        Serial.print(now.day());
        Serial.print(" | Waktu: ");
        Serial.print(now.hour());
        Serial.print(':');
        Serial.print(now.minute());
        Serial.print(':');
        Serial.println(now.second());
    } 
    delay(2000);
}